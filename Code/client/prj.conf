## CMakeLists.txt
```
cmake_minimum_required(VERSION 3.20.0)

set(CMAKE_EXPORT_COMPILE_COMMANDS ON)

find_package(Zephyr REQUIRED HINTS $ENV{ZEPHYR_BASE})

project(touche_client)

target_sources(app PRIVATE
    src/main.c
    src/alive.c

    src/button/button.c
    src/button/button.h

    src/mac_address/mac_address.c
    src/mac_address/mac_address.h

    ../shared/led/led.c
    ../shared/led/led.h

    ../shared/radio/radio.c
    ../shared/radio/radio.h
    )

target_include_directories(app PRIVATE
        ../shared
        ../shared/radio
        ../shared/led
    )
```

## prj.conf
```kconfig
# gpio
CONFIG_GPIO=y

# enable logs
CONFIG_LOG=y
CONFIG_LOG_MODE_IMMEDIATE=y

# pwm (led / buzzer)
CONFIG_PWM=y

# Enhanced ShockBurst
CONFIG_ESB=y

# enable __ASSERT macro
CONFIG_ASSERT=y
```

## src/main.c
```c
#include "button/button.h"
#include "led/led.h"
#include "protocol.h"
#include "mac_address/mac_address.h"
#include "radio/radio.h"
#include "alive.h"

#include <assert.h>
#include <logging/log.h>
#include <stdlib.h>
#include <zephyr.h>

LOG_MODULE_REGISTER(main_client, LOG_LEVEL_INF);

struct k_timer my_timer;

static void print_boot_header(const uint8_t *mac_addr)
{
    LOG_INF("Starting client...");
    LOG_HEXDUMP_INF(mac_addr, 6 * sizeof(uint8_t), "Mac address");
}

void main()
{
    uint8_t mac_address[6];
    mac_address_get(mac_address);

    print_boot_header(mac_address);

    // init led
    __ASSERT(led_init() == EXIT_SUCCESS, "Led init failed");

    // init button
    __ASSERT(button_init() == EXIT_SUCCESS, "Button init failed");

    // init radio
    __ASSERT(radio_init() == EXIT_SUCCESS, "Radio init failed");

    // blink led after init
    led_blink(750, 1);

    // init alive led blinking
    alive_timer_start();

    while (true) {
        if (button_get_state()) {
            alive_timer_reset();
            LOG_INF("Sending HIT");
            radio_send_msg(HIT);
            k_sleep(K_MSEC(FENCING_BLINKING_TIME));
        }
    }
}
```

## src/main.cpp
```c
/*
Touché Project
Copyright (C) 2024 Assouline Yohann

This program is free software: you can redistribute it and/or modify
it under the terms of the GNU General Public License as published by
the Free Software Foundation, either version 3 of the License, or
any later version.

This program is distributed in the hope that it will be useful,
but WITHOUT ANY WARRANTY; without even the implied warranty of
MERCHANTABILITY or FITNESS FOR A PARTICULAR PURPOSE.  See the
GNU General Public License for more details.

You should have received a copy of the GNU General Public License
along with this program.  If not, see <http://www.gnu.org/licenses/>.
*/

#include "ArduinoLog.h"
#include "PlayerConfig.hpp"
#include "RGBLed.hpp"
#include "RadioModule.hpp"
#include "Timer.hpp"
#include "VirtualGround.hpp"
#include "Weapon.hpp"
#include "config.h"
#include "protocol.h"
#include "touche.h"
#include "utils.hpp"

#include <Arduino.h>

// Global classes
VirtualGround virtualGround(VIRTUAL_PIN_OUT, VIRTUAL_PIN_IN);
RadioModule radio_module(NRF24L01_CE_PIN, NRF24L01_CS_PIN);
Weapon weapon(EPEE_BUTTON_PIN, virtualGround);
static RGBLed led(LED_PIN_RED, LED_PIN_GREEN, LED_PIN_BLUE);
static Timer timerValidHit;
static Timer timerInvalidHit;
static Timer timerButtonMaintened;
PlayerConfig config(PLAYER_ROLE, DEFAULT_WEAPON_MODE);

void run_calibration_process();

/**
 * @brief callback needed for arduino-log
 */
static void printLineEnding(Print *_logOutput)
{
    _logOutput->print(CRLF);
}

void setup()
{
#ifndef DISABLE_LOGGING
    Serial.flush();
    Serial.begin(9600);

    // view available log level here : https://github.com/Yohannfra/Arduino-Log
    Log.begin(LOG_LEVEL_VERBOSE, &Serial, true);
    Log.setSuffix(printLineEnding);
#endif

    Log.trace(CRLF "==== Booting client ====" CRLF);

    Log.notice("Role: %s", config.getRole() == PLAYER_1 ? "PLAYER_1" : "PLAYER_2");
    Log.notice("Weapon: %s", config.getWeapon() == EPEE ? "EPEE" : "FOIL");

    radio_module.init(config.getRole());

    led.blink(RGBLed::WEAPON_MODE_TO_COLOR(config.getWeapon()), 1000, 1);
}

static void applyAckSettings(ack_payload_t ack)
{
    if (ack == ACK_ERROR) {
        Log.warning("ack is ACK_ERROR");
        return;
    }

    utils::print_ack_payload(ack);

    config.setPisteMode(ack & ACK_PISTE_MODE);

    if (ack & ACK_EPEE && config.getWeapon() != EPEE) {
        config.setWeapon(EPEE);
        virtualGround.reset();
    } else if (ack & ACK_FOIL && config.getWeapon() != FOIL) {
        config.setWeapon(FOIL);
        virtualGround.reset();
    } else if (ack & ACK_SABRE) {
        // config.setWeapon(SABRE);
    }

    Log.notice("Weapon is now : %s", config.getWeapon() == FOIL ? "FOIL" : "EPEE");
    Log.notice("Piste is now : %s", config.getPisteMode() ? "Enabled" : "Disabled");
}

void loop()
{
    Weapon::hit_status_e hit_status = weapon.isHitting(config.getWeapon());

    if (hit_status != Weapon::NONE) {
        if (!timerButtonMaintened.isRunning()) {
            timerButtonMaintened.start();
        }

        if (hit_status == Weapon::VALID && !timerValidHit.isRunning()) {
            Log.notice("== Valid hit ==");
            timerValidHit.start();
            led.setColor(RGBLed::GREEN);
            applyAckSettings(radio_module.sendMsg(HIT));
            timerInvalidHit.reset();
        } else if (!timerInvalidHit.isRunning() && !timerValidHit.isRunning()) {  // INVALID HIT
            Log.notice("== Invalid hit ==");
            if (config.getWeapon() == FOIL) {
                applyAckSettings(radio_module.sendMsg(INVALID_HIT));
            }
            timerInvalidHit.start();
            led.setColor(RGBLed::RED);
        }

        if (timerButtonMaintened.isRunning() &&
            timerButtonMaintened.getTimeElapsed() > 2000 /* 2 secs */) {  // calibration
            run_calibration_process();
            timerButtonMaintened.reset();
        }
    } else {  // No hit occuring
        timerButtonMaintened.reset();

        if (timerValidHit.getTimeElapsed() > FENCING_BLINKING_TIME ||
            timerInvalidHit.getTimeElapsed() > FENCING_BLINKING_TIME) {  // reset all
            Log.notice("Reset");
            led.turnOff();
            timerValidHit.reset();
            timerInvalidHit.reset();
        }
    }
}
```

## include/config.h
```c
/*
Touché Project
Copyright (C) 2024 Assouline Yohann

This program is free software: you can redistribute it and/or modify
it under the terms of the GNU General Public License as published by
the Free Software Foundation, either version 3 of the License, or
any later version.

This program is distributed in the hope that it will be useful,
but WITHOUT ANY WARRANTY; without even the implied warranty of
MERCHANTABILITY or FITNESS FOR A PARTICULAR PURPOSE.  See the
GNU General Public License for more details.

You should have received a copy of the GNU General Public License
along with this program.  If not, see <http://www.gnu.org/licenses/>.
*/

#ifndef CONFIG_H
#define CONFIG_H

// ------ Config ------------

// Change that to 1 if you want to change a board from PLAYER_1 to PLAYER_2
// but reflash with 0 after doing so to preserve EEPROM
#define FORCE_WRITE_PLAYER_ROLE 0

#ifndef PLAYER_ROLE
    #define PLAYER_ROLE PLAYER_1  // change value to PLAYER_1 or PLAYER_2
#endif

// ------ Pinout ------------

/**
 * @brief Arduino pin used for the led
 */
#define LED_PIN_RED 10
#define LED_PIN_GREEN 6
#define LED_PIN_BLUE 9

/**
 * @brief Arduino pin for the button of the weapon
 */
#define EPEE_BUTTON_PIN 3

/**
 * @brief Arduino pin for chip enable pin of NRF24L01
 */
#define NRF24L01_CE_PIN 7

/**
 * @brief Arduino pin for chip select pin of NRF24L01
 */
#define NRF24L01_CS_PIN 8

/**
 * @brief Arduino pin for capacitive sensor in
 */
#define VIRTUAL_PIN_IN 2

/**
 * @brief Arduino pin for capacitive sensor out
 */
#define VIRTUAL_PIN_OUT 4

#endif  // CONFIG_H
```

## src/alive.c
```c
#include <zephyr.h>
#include "led.h"

static void alive_led_blinker_worker(struct k_work *work)
{
    led_set();
    k_sleep(K_MSEC(250));
    led_clear();
}

K_WORK_DEFINE(alive_led_blinker, alive_led_blinker_worker);

static void alive_timer_timeout_handler(struct k_timer *timer_id)
{
    k_work_submit(&alive_led_blinker);
}

K_TIMER_DEFINE(alive_timer, alive_timer_timeout_handler, NULL);

void alive_timer_start(void)
{
    k_timer_start(&alive_timer, K_SECONDS(0), K_SECONDS(5));
}

void alive_timer_reset(void)
{
    k_timer_start(&alive_timer, K_SECONDS(5), K_SECONDS(5));
}
```

## src/alive.h
```c
#ifndef TOUCHE_CLIENT_ALIVE_H
#define TOUCHE_CLIENT_ALIVE_H

void alive_timer_start(void);

void alive_timer_reset(void);

#endif
```

## src/calibration.cpp
```c
/*
Touché Project
Copyright (C) 2024 Assouline Yohann

This program is free software: you can redistribute it and/or modify
it under the terms of the GNU General Public License as published by
the Free Software Foundation, either version 3 of the License, or
any later version.

This program is distributed in the hope that it will be useful,
but WITHOUT ANY WARRANTY; without even the implied warranty of
MERCHANTABILITY or FITNESS FOR A PARTICULAR PURPOSE.  See the
GNU General Public License for more details.

You should have received a copy of the GNU General Public License
along with this program.  If not, see <http://www.gnu.org/licenses/>.
*/

#include "ArduinoLog.h"
#include "PlayerConfig.hpp"
#include "RadioModule.hpp"
#include "VirtualGround.hpp"
#include "Weapon.hpp"
#include "protocol.h"
#include "touche.h"
#include "utils.hpp"

#include <Arduino.h>

extern VirtualGround virtualGround;
extern RadioModule radio_module;
extern PlayerConfig config;
extern Weapon weapon;

void run_calibration_process()
{
    Log.notice("== Starting calibration ==");
    radio_module.sendMsg(CALIBRATION_STARTING);

    while (virtualGround.calibrate() == false) {
        if (weapon.isHitting(config.getWeapon(), false) == Weapon::NONE) {
            Log.warning("Button released during calibration");
            radio_module.sendMsg(CALIBRATION_FAILED);
            virtualGround.end_calibration(false);
            delay(500);
            return;
        }
    }
    Log.notice("== Calibration Done ==");
    virtualGround.end_calibration(true);
    radio_module.sendMsg(CALIBRATION_END);
    delay(500);
}
```
